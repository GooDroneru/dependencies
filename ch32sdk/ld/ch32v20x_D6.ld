/* CH32V20x_D6 - CH32V203F8-CH32V203G8-CH32V203K8-CH32V203C8
 * Flash: 64K, RAM: 20K
 */

MEMORY
{
    FLASH (rx)  : ORIGIN = 0x00000000, LENGTH = 64K
    RAM   (xrw) : ORIGIN = 0x20000000, LENGTH = 20K
}

INCLUDE ch32v20x.ld
