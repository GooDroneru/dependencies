# K1921VG5T register map
Vendor: NIIET; Series: K1921VKx; File version: 1.1
Motor control MCU (core RISC-V SCR4)
CPU: CM4 r0p1, Endian.LITTLE endian, MPU, FPU
Registers are 32-bit, read-write, reset 0x0 unless marked. A register's access mark holds for its fields unless they carry their own. Offsets are from the block's base; lines under a group give offsets from that group; [hi:lo] are bit positions; {n}, {i} and the like mark numbered series; 'fields as' and 'values as' point back to an identical list; <NAME> marks a mode.

## Memory map
0x40000000 GPIOA size 0xC00 — GPIO control registers
0x40001000 GPIOB size 0xC00
0x40010000 CAN size 0x400 — CAN control registers
0x40011000 CANMSG size 0x2000 — CAN message registers
0x40020000 ADC size 0x694 — ADC control registers
0x50000000 DMA size 0x2061 — DMA control registers
0x50002000 FLASH size 0x110 — Flash status and control module
0x50003000 SIU size 0x54 — System integration unit
0x50004000 RCU size 0xC8 — Reset and clock unit
0x50005000 RTC size 0x60 — RTC control registers
0x50006000 WDT size 0xC04 — Watchdog timer
0x50007000 I2C size 0x48 — I2C control registers
0x50008000 QEP size 0x74 — Quadrature Encoder control registers
0x50009000 CAP0 size 0x4C — Capture unit control registers
0x5000A000 CAP1 size 0x4C
0x5000B000 CAP2 size 0x4C
0x5000C000 PWM0 size 0x9C — PWM control registers
0x5000D000 PWM1 size 0x9C
0x5000E000 PWM2 size 0x9C
0x5000F000 SPI0 size 0x28 — SPI control registers
0x50010000 SPI1 size 0x28
0x50011000 TMR0 size 0x118 — Timer 32-bit control registers
0x50012000 TMR1 size 0x118
0x50013000 TMR2 size 0x118
0x50014000 TMR3 size 0x118
0x50015000 UART0 size 0x4C — UART control registers
0x50016000 UART1 size 0x4C

## Interrupts
1 WDT — Watchdog timer interrupt
2 RCU — Reset Clock unit interrupt
3 RTC — Real-Time Clock interrupt
4 FLASH — FLASH interrupt
5 GPIOA — GPIO A interrupt
6 GPIOB — GPIO B interrupt
{n+7} CAN{n} (CAN) (n=0..15) — CAN{n} interrupt
{n+23} DMA_CH{n} (DMA) (n=0..15) — DMA channel {n} interrupt
39 CAP0 — Capture unit 0 interrupt
40 CAP1 — Capture unit 1 interrupt
41 CAP2 — Capture unit 2 interrupt
42 TMR0 — Timer 0 combine interrupt
43 TMR0_PERIOD (TMR0) — Timer 0 period interrupt
44 TMR0_CC0 (TMR0) — Timer 0 CAPCOM 0 interrupt
45 TMR0_CC1 (TMR0) — Timer 0 CAPCOM 1 interrupt
46 TMR1 — Timer 1 combine interrupt
47 TMR1_PERIOD (TMR1) — Timer 1 period interrupt
48 TMR1_CC0 (TMR1) — Timer 1 CAPCOM 0 interrupt
49 TMR1_CC1 (TMR1) — Timer 1 CAPCOM 1 interrupt
50 TMR2 — Timer 2 combine interrupt
51 TMR2_PERIOD (TMR2) — Timer 2 period interrupt
52 TMR2_CC0 (TMR2) — Timer 2 CAPCOM 0 interrupt
53 TMR2_CC1 (TMR2) — Timer 2 CAPCOM 1 interrupt
54 TMR3 — Timer 3 combine interrupt
55 TMR3_PERIOD (TMR3) — Timer 3 period interrupt
56 TMR3_CC0 (TMR3) — Timer 3 CAPCOM 0 interrupt
57 TMR3_CC1 (TMR3) — Timer 3 CAPCOM 1 interrupt
58 I2C — I2C interrupt
59 QEP — QEP interrupt
60 ADC_SEQ0 (ADC) — ADC Sequencer 0 interrupt
61 ADC_SEQ1 (ADC) — ADC Sequencer 1 interrupt
62 ADC_DC0 (ADC) — ADC Digital Comparator 0 interrupt
63 ADC_DC1 (ADC) — ADC Digital Comparator 1 interrupt
64 ADC_DC2 (ADC) — ADC Digital Comparator 2 interrupt
65 ADC_DC3 (ADC) — ADC Digital Comparator 3 interrupt
66 SPI0 — SPI0 interrupt
67 SPI0_RX (SPI0) — SPI0 Receive interrupt
68 SPI0_TX (SPI0) — SPI0 Transmit interrupt
69 SPI0_RO (SPI0) — SPI0 Receive Overrun interrupt
70 SPI0_RT (SPI0) — SPI0 Receive Timeout interrupt
71 SPI1 — SPI1 interrupt
72 SPI1_RX (SPI1) — SPI1 Receive interrupt
73 SPI1_TX (SPI1) — SPI1 Transmit interrupt
74 SPI1_RO (SPI1) — SPI1 Receive Overrun interrupt
75 SPI1_RT (SPI1) — SPI1 Receive Timeout interrupt
76 UART0 — UART0 interrupt
77 UART0_TD (UART0) — UART0 Transmit Done interrupt
78 UART0_RX (UART0) — UART0 Recieve interrupt
79 UART0_TX (UART0) — UART0 Transmit interrupt
80 UART0_RT (UART0) — UART0 Recieve interrupt
81 UART0_E (UART0) — UART0 Error interrupt
82 UART1 — UART1 interrupt
83 UART1_TD (UART1) — UART1 Transmit Done interrupt
84 UART1_RX (UART1) — UART1 Recieve interrupt
85 UART1_TX (UART1) — UART1 Transmit interrupt
86 UART1_RT (UART1) — UART1 Recieve interrupt
87 UART1_E (UART1) — UART1 Error interrupt
88 PWM0 — PWM0 interrupt
89 PWM0_HD (PWM0) — PWM0 HD interrupt
90 PWM0_TZ (PWM0) — PWM0 TZ interrupt
91 PWM1 — PWM1 interrupt
92 PWM1_HD (PWM1) — PWM1 HD interrupt
93 PWM1_TZ (PWM1) — PWM1 TZ interrupt
94 PWM2 — PWM2 interrupt
95 PWM2_HD (PWM2) — PWM2 HD interrupt
96 PWM2_TZ (PWM2) — PWM2 TZ interrupt
97 RTC_ALARM1 (RTC) — RTC_ALARM1 interrupt
98 RTC_ALARM2 (RTC) — RTC_ALARM2 interrupt
99 RTC_BAT (RTC) — RTC_BAT interrupt
100 RTC_POWEROK (RTC) — RTC_POWEROK interrupt

## Licence text in the file
THIS SOFTWARE IS PROVIDED "AS IS". NO WARRANTIES, WHETHER EXPRESS, IMPLIED OR STATUTORY, INCLUDING, BUT NOT LIMITED TO, IMPLIED WARRANTIES OF MERCHANTABILITY AND FITNESS FOR A PARTICULAR PURPOSE APPLY TO THIS SOFTWARE. ARM SHALL NOT, IN ANY CIRCUMSTANCES, BE LIABLE FOR SPECIAL, INCIDENTAL, OR CONSEQUENTIAL DAMAGES, FOR ANY REASON WHATSOEVER.
